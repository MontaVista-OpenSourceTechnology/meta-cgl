## meta-cgl-common/conf/distro/include/cgl_common_security_flags.inc
```bitbake
SECURITY_LDFLAGS_remove_pn-audit = "-fstack-protector-strong"

SECURITY_CFLAGS_pn-ocfs2-tools = "${SECURITY_NOPIE_CFLAGS}"
SECURITY_LDFLAGS_pn-ocfs2-tools = ""
```

## meta-cgl-common/conf/distro/poky-cgl.conf
```bitbake
require conf/distro/poky-altcfg.conf

DISTRO = "poky-cgl"
DISTROOVERRIDES .= ":poky-cgl"

DISTRO_FEATURES:append = " selinux ptest argp ext2 xattr nfs pci ipv4 ipv6"

PREFERRED_PROVIDER_virtual/refpolicy="refpolicy-targeted"

# we want to use rsyslog as the default syslog, but it's GPLv3, so need this
# check to switch to syslog-ng if GLPv3 is blacklisted.
VIRTUAL-RUNTIME_syslog ?= "${@bb.utils.contains('INCOMPATIBLE_LICENSE', 'GPLv3', 'syslog-ng', 'rsyslog', d)}"
```

## meta-cgl-common/conf/layer.conf
```bitbake
# We have a conf and classes directory, add to BBPATH
BBPATH .= ":${LAYERDIR}"

# We have recipes-* directories, add to BBFILES
BBFILES += "${LAYERDIR}/recipes-*/*/*.bb \
	${LAYERDIR}/recipes-*/*/*.bbappend"

BBFILE_COLLECTIONS += "cgl-common"
BBFILE_PATTERN_cgl-common = "^${LAYERDIR}/"
BBFILE_PRIORITY_cgl-common = "7"

LAYERDEPENDS_cgl-common = "core openembedded-layer networking-layer perl-layer filesystems-layer security selinux yocto"

LAYERSERIES_COMPAT_cgl-common = "honister kirkstone langdale mickledore nanbield scarthgap styhead"

require conf/distro/include/cgl_common_security_flags.inc
```
